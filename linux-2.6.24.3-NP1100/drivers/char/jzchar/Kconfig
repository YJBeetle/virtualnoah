## linux-2.6.24.3-NP1100/drivers/char/jzchar/Kconfig
```kconfig
#
# JzSOC char devices configuration
#

menu "JZSOC char device support"
	depends on SOC_JZ4740 || SOC_JZ4730 || SOC_JZ4750 || SOC_JZ4750D

config JZCHAR
	tristate 'JzSOC char device support'

config JZ_CAMERA_SENSOR
	bool

config JZ_CIM
	tristate 'JzSOC Camera Interface Module (CIM) support'
	depends on JZCHAR
	select JZ_CAMERA_SENSOR

config JZ_TPANEL_ATA2508
	tristate 'JzSOC MPEG4 TOUCH PANEL ATA2508 support'
	depends on JZCHAR

config JZ_TPANEL
	tristate 'JzSOC touchpanel driver support' 
	depends on JZCHAR
#	select JZ_SADC if SOC_JZ4740
#	select JZ_TPANEL_AK4182 if SOC_JZ4730

choice
	prompt "Touch Panel ADC type"
	depends on JZ_TPANEL
	default JZ_SADC if SOC_JZ4740 || SOC_JZ4750 || SOC_JZ4750D
	default JZ_TPANEL_AK4182 if SOC_JZ4730

config JZ_SADC
	bool 'Select the JZ47XX internal SADC'

config JZ_TPANEL_AK4182
	bool 'Select the AK4182 codec'

config JZ_TPANEL_UCB1400
	bool 'Select the UCB1400 codec'

config JZ_TPANEL_WM9712
	bool 'Select the WM9712 codec'

endchoice

config JZ_UDC_HOTPLUG
	tristate 'JZ UDC hotplug driver support'
	depends on JZCHAR

config JZ_POWEROFF
	tristate 'JZ board poweroff support' 
	depends on JZCHAR

config JZ_OW
	tristate 'JZ One-wire bus support' 
	depends on JZCHAR

config JZ_TCSM
	tristate 'JZ TCSM support' 
	depends on JZCHAR

config JZ_TSSI
	tristate 'JZ MPEG2-TS interface support' 
	depends on JZCHAR && (SOC_JZ4750 || SOC_JZ4750D)

endmenu
```

## linux-2.6.24.3-NP1100/drivers/mmc/host/Kconfig
```kconfig
#
# MMC/SD host controller drivers
#

comment "MMC/SD Host Controller Drivers"

config MMC_JZ
	tristate "JZ SD/Multimedia Card Interface support"
	depends on SOC_JZ4730 || SOC_JZ4740
	help
	  This selects the Ingenic JZ4730/JZ4740 SD/Multimedia card Interface.
	  If you have abIngenic platform with a Multimedia Card slot,
	  say Y or M here.

	  If unsure, say N.
choice
	depends on MMC_JZ
	prompt "MMC BUS Width"
	default JZ_MMC_BUS_4
	help
	This defines the BUS Width of the Ingenic JZ4730/JZ4740 SD/Multimedia card Interface.

config JZ_MMC_BUS_1
	bool "1 Bit Bus"
	help
	 1 Bit SD/Multimedia Card Bus

config JZ_MMC_BUS_4
	bool "4 Bit Bus"
	help
	 4 Bit SD/Multimedia Card Bus

endchoice

config MSC0_JZ4750
	tristate "JZ4750 SD/Multimedia Card 0 Interface support"
	depends on SOC_JZ4750 || SOC_JZ4750D
	help
	  This selects the Ingenic JZ4750 SD/Multimedia card 0 Interface.
	  If you have a Ingenic platform with a Multimedia Card slot,
	  say Y or M here.

	  If unsure, say N.

choice
	depends on MSC0_JZ4750
	prompt "MSC0 BUS Width"
	default JZ4750_MSC0_BUS_4
	help
	This defines the BUS Width of the Ingenic JZ4750 SD/Multimedia card Interface.

config JZ4750_MSC0_BUS_1
	bool "1 Bit Bus"
	help
	 1 Bit SD/Multimedia Card Bus

config JZ4750_MSC0_BUS_4
	bool "4 Bit Bus"
	help
	 4 Bit SD/Multimedia Card Bus

config JZ4750_MSC0_BUS_8
	bool "8 Bit Bus"
	help
	 8 Bit Multimedia Card Bus

endchoice

config MSC1_JZ4750
	tristate "JZ4750 SD/Multimedia Card 1 Interface support"
	depends on SOC_JZ4750 || SOC_JZ4750D
	help
	  This selects the Ingenic JZ4750 SD/Multimedia card 1 Interface.
	  If you have a Ingenic platform with a Multimedia Card slot,
	  say Y or M here.

	  If unsure, say N.

choice
	depends on MSC1_JZ4750
	prompt "MSC1 BUS Width"
	default JZ4750_MSC1_BUS_4
	help
	This defines the BUS Width of the Ingenic JZ4750 SD/Multimedia card Interface.

config JZ4750_MSC1_BUS_1
	bool "1 Bit Bus"
	help
	 1 Bit SD/Multimedia Card Bus

config JZ4750_MSC1_BUS_4
	bool "4 Bit Bus"
	help
	 4 Bit SD/Multimedia Card Bus
endchoice

config JZ4750_BOOT_FROM_MSC0
	tristate "JZ4750 Boot from SD/Multimedia Card Interface support"
	depends on SOC_JZ4750 || SOC_JZ4750D
	help
	  This selects boot from the Sd/Multimedia Card.

	  If unsure,say N.

config MMC_ARMMMCI
	tristate "ARM AMBA Multimedia Card Interface support"
	depends on ARM_AMBA
	help
	  This selects the ARM(R) AMBA(R) PrimeCell Multimedia Card
	  Interface (PL180 and PL181) support.  If you have an ARM(R)
	  platform with a Multimedia Card slot, say Y or M here.

	  If unsure, say N.

config MMC_PXA
	tristate "Intel PXA25x/26x/27x Multimedia Card Interface support"
	depends on ARCH_PXA
	help
	  This selects the Intel(R) PXA(R) Multimedia card Interface.
	  If you have a PXA(R) platform with a Multimedia Card slot,
	  say Y or M here.

	  If unsure, say N.

config MMC_SDHCI
	tristate "Secure Digital Host Controller Interface support  (EXPERIMENTAL)"
	depends on PCI && EXPERIMENTAL
	help
	  This select the generic Secure Digital Host Controller Interface.
	  It is used by manufacturers such as Texas Instruments(R), Ricoh(R)
	  and Toshiba(R). Most controllers found in laptops are of this type.
	  If you have a controller with this interface, say Y or M here.

	  If unsure, say N.

config MMC_RICOH_MMC
	tristate "Ricoh MMC Controller Disabler  (EXPERIMENTAL)"
	depends on PCI && EXPERIMENTAL && MMC_SDHCI
	help
	  This selects the disabler for the Ricoh MMC Controller. This
	  proprietary controller is unnecessary because the SDHCI driver
	  supports MMC cards on the SD controller, but if it is not
	  disabled, it will steal the MMC cards away - rendering them
	  useless. It is safe to select this driver even if you don't
	  have a Ricoh based card reader.


	  To compile this driver as a module, choose M here:
	  the module will be called ricoh_mmc.

	  If unsure, say Y.

config MMC_OMAP
	tristate "TI OMAP Multimedia Card Interface support"
	depends on ARCH_OMAP
	select TPS65010 if MACH_OMAP_H2
	help
	  This selects the TI OMAP Multimedia card Interface.
	  If you have an OMAP board with a Multimedia Card slot,
	  say Y or M here.

	  If unsure, say N.

config MMC_WBSD
	tristate "Winbond W83L51xD SD/MMC Card Interface support"
	depends on ISA_DMA_API
	help
	  This selects the Winbond(R) W83L51xD Secure digital and
          Multimedia card Interface.
	  If you have a machine with a integrated W83L518D or W83L519D
	  SD/MMC card reader, say Y or M here.

	  If unsure, say N.

config MMC_AU1X
	tristate "Alchemy AU1XX0 MMC Card Interface support"
	depends on SOC_AU1200
	help
	  This selects the AMD Alchemy(R) Multimedia card interface.
	  If you have a Alchemy platform with a MMC slot, say Y or M here.

	  If unsure, say N.

config MMC_AT91
	tristate "AT91 SD/MMC Card Interface support"
	depends on ARCH_AT91
	help
	  This selects the AT91 MCI controller.

	  If unsure, say N.

config MMC_IMX
	tristate "Motorola i.MX Multimedia Card Interface support"
	depends on ARCH_IMX
	help
	  This selects the Motorola i.MX Multimedia card Interface.
	  If you have a i.MX platform with a Multimedia Card slot,
	  say Y or M here.

	  If unsure, say N.

config MMC_TIFM_SD
	tristate "TI Flash Media MMC/SD Interface support  (EXPERIMENTAL)"
	depends on EXPERIMENTAL && PCI
	select TIFM_CORE
	help
	  Say Y here if you want to be able to access MMC/SD cards with
	  the Texas Instruments(R) Flash Media card reader, found in many
	  laptops.
	  This option 'selects' (turns on, enables) 'TIFM_CORE', but you
	  probably also need appropriate card reader host adapter, such as
	  'Misc devices: TI Flash Media PCI74xx/PCI76xx host adapter support
	  (TIFM_7XX1)'.

          To compile this driver as a module, choose M here: the
	  module will be called tifm_sd.

config MMC_SPI
	tristate "MMC/SD over SPI (EXPERIMENTAL)"
	depends on MMC && SPI_MASTER && !HIGHMEM && EXPERIMENTAL
	select CRC7
	select CRC_ITU_T
	help
	  Some systems accss MMC/SD cards using a SPI controller instead of
	  using a "native" MMC/SD controller.  This has a disadvantage of
	  being relatively high overhead, but a compensating advantage of
	  working on many systems without dedicated MMC/SD controllers.

	  If unsure, or if your system has no SPI master driver, say N.
```
